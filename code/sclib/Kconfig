## code/sclib/Kconfig
```kconfig
module = SCLIB
module-str = sclib
source "subsys/logging/Kconfig.template.log_config"

config SCLIB_MAX_SIGNAL_LENGTH_MS
	int "Maximum signal length in ms"
	default 3000
	help
	  Maximum signal length in ms

config SCLIB_MAX_SIGNAL_DIFF_MS
	int "Maximum signal difference in ms"
	default 500
	help
	  Maximum signal difference in ms

config SCLIB_DTW_USE_WINDOWING
	bool "Use windowing in DTW"
	default y
	help
	  Use windowing in DTW

config SCLIB_DTW_WINDOW_SIZE
	int "Window size in DTW"
	default 20
	depends on SCLIB_DTW_USE_WINDOWING
	help
	  Window size in DTW
```

## code/sclib/boards/arm/spellcaster_nrf52833/Kconfig
```kconfig
if BOARD_SPELLCASTER_NRF52833

config BOARD_ENABLE_DCDC
	bool "DCDC mode"
	select SOC_DCDC_NRF52X
	default y

endif  # BOARD_SPELLCASTER_NRF52833
```

## code/sclib/boards/arm/spellcaster_nrf52833/Kconfig.board
```kconfig
config BOARD_SPELLCASTER_NRF52833
	bool "spellcaster nRF52833 board"
	depends on SOC_NRF52833_QIAA
```

## code/sclib/boards/arm/spellcaster_nrf52833/Kconfig.defconfig
```kconfig
if BOARD_SPELLCASTER_NRF52833

config BOARD
	default "spellcaster_nrf52833"

config BOARD_REVISION
	string "Board revision."
	default "0.0.0"

config BOARD_REVISION_CODE
	int "Board revision code. An integer representation of the board revision."
	default 0

config BT_CTLR
	default BT

endif  # BOARD_SPELLCASTER_NRF52833
```
