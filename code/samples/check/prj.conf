## CMakeLists.txt
```
cmake_minimum_required(VERSION 3.20.0)

# Pull in the dts/ and boards/ from sclib.
set(DTS_ROOT ${CMAKE_CURRENT_SOURCE_DIR}/../../sclib)
set(BOARD_ROOT ${CMAKE_CURRENT_SOURCE_DIR}/../../sclib)

find_package(Zephyr REQUIRED HINTS $ENV{ZEPHYR_BASE})
project(soil_read_loop)

target_sources(app PRIVATE src/main.c)

add_subdirectory(../../sclib sclib)
target_include_directories(app PRIVATE ../../sclib/include)
target_link_libraries(app PUBLIC sclib)
```

## prj.conf
```kconfig
CONFIG_PINCTRL=y
CONFIG_I2C=y
CONFIG_LOG=y
CONFIG_PWM=y
CONFIG_PWM_LOG_LEVEL_DBG=y
CONFIG_CBPRINTF_FP_SUPPORT=y
CONFIG_ADC=y
CONFIG_GPIO=y
CONFIG_PM=y
CONFIG_PM_DEVICE=y
CONFIG_USE_SEGGER_RTT=y
CONFIG_SEGGER_RTT_BUFFER_SIZE_UP=4096

CONFIG_ASSERT=y

CONFIG_NEWLIB_LIBC=y

CONFIG_MAIN_STACK_SIZE=2048
CONFIG_FLASH=y
CONFIG_FLASH_MAP=y
CONFIG_FLASH_PAGE_LAYOUT=y
CONFIG_FILE_SYSTEM=y
CONFIG_FILE_SYSTEM_LITTLEFS=y
```

## src/main.c
```c
#include <math.h>
#include <sclib/accel.h>
#include <sclib/led.h>
#include <sclib/macros.h>
#include <sclib/vibration.h>
#include <zephyr/kernel.h>
#include <zephyr/logging/log.h>

LOG_MODULE_REGISTER(main, LOG_LEVEL_DBG);

int main(void) {
  __ASSERT_NO_MSG(!sc_led_init());
  __ASSERT_NO_MSG(!sc_vib_init());
  __ASSERT_NO_MSG(!sc_accel_init());

  struct sc_accel_entry entry;
  float angle;
  while (true) {
    if (!sc_accel_read(&entry)) {
      angle = atan2(-1 * entry.ax, entry.az) * 180 / 3.14159265;
      LOG_DBG("%10d %10d %10d %10d %10d %10d %10.2f deg", entry.ax, entry.ay,
              entry.az, entry.gx, entry.gy, entry.gz, angle);
    }
    k_sleep(K_MSEC(10));
  }
}
```
