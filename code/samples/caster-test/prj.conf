## CMakeLists.txt
```
cmake_minimum_required(VERSION 3.20.0)

# Pull in the dts/ and boards/ from sclib.
set(DTS_ROOT ${CMAKE_CURRENT_SOURCE_DIR}/../../sclib)
set(BOARD_ROOT ${CMAKE_CURRENT_SOURCE_DIR}/../../sclib)

find_package(Zephyr REQUIRED HINTS $ENV{ZEPHYR_BASE})
project(caster-test)

target_sources(app PRIVATE src/main.c)

add_subdirectory(../../sclib sclib)
target_include_directories(app PRIVATE ../../sclib/include)
target_link_libraries(app PUBLIC sclib)
```

## prj.conf
```kconfig
CONFIG_PINCTRL=y
CONFIG_I2C=y
CONFIG_LOG=y
CONFIG_PWM=y
# CONFIG_PWM_LOG_LEVEL_DBG=y
CONFIG_CBPRINTF_FP_SUPPORT=y
CONFIG_ADC=y
CONFIG_GPIO=y
CONFIG_PM=y
CONFIG_PM_DEVICE=y
CONFIG_USE_SEGGER_RTT=y
CONFIG_ASSERT=y
CONFIG_NEWLIB_LIBC=y

# So we can use pin P0.10 as GPIO.
CONFIG_NFCT_PINS_AS_GPIOS=y

# Uncomment for debug log level.
# CONFIG_LOG_DEFAULT_LEVEL=4

# LittleFS.
CONFIG_MAIN_STACK_SIZE=2048
CONFIG_FLASH=y
CONFIG_FLASH_MAP=y
CONFIG_FLASH_PAGE_LAYOUT=y
CONFIG_FILE_SYSTEM=y
CONFIG_FILE_SYSTEM_LITTLEFS=y

# Disable MCUboot.
CONFIG_BOOTLOADER_MCUBOOT=n
```

## src/main.c
```c
#include <sclib/accel.h>
#include <sclib/caster.h>
#include <sclib/led.h>
#include <sclib/macros.h>
#include <sclib/motion_detector.h>
#include <zephyr/kernel.h>
#include <zephyr/logging/log.h>

LOG_MODULE_REGISTER(main, LOG_LEVEL_DBG);

void caster_cb(uint8_t slot) {
  LOG_DBG("Caster callback for slot %d", slot);
}

int main(void) {
  __ASSERT_NO_MSG(!sc_caster_init(caster_cb));
  while (true) {
    k_sleep(K_FOREVER);
  }
}
```
