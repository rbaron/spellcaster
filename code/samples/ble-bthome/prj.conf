## CMakeLists.txt
```
cmake_minimum_required(VERSION 3.20.0)

# Pull in the dts/ and boards/ from sclib.
set(DTS_ROOT ${CMAKE_CURRENT_SOURCE_DIR}/../../sclib)
set(BOARD_ROOT ${CMAKE_CURRENT_SOURCE_DIR}/../../sclib)

find_package(Zephyr REQUIRED HINTS $ENV{ZEPHYR_BASE})
project(ble-bthome)

target_sources(app PRIVATE
	src/main.c
	src/ble.c
)

add_subdirectory(../../sclib sclib)
target_include_directories(app PRIVATE ../../sclib/include)
target_link_libraries(app PUBLIC sclib)
```

## Kconfig
```
source "Kconfig.zephyr"
rsource "../../sclib/Kconfig"

config SC_BLE_ADV_DURATION_MSEC
	int "Advertising duration in ms."
	default 500

config SC_BLE_MIN_ADV_INTERVAL
	int "Minimum advertising interval in milliseconds"
	default 30

config SC_BLE_MAX_ADV_INTERVAL
	int "Maximum advertising interval in milliseconds"
	default 40
```

## prj.conf
```kconfig
# CONFIG_PINCTRL=y
CONFIG_I2C=y
CONFIG_LOG=y
# CONFIG_LOG_MODE_MINIMAL=y
CONFIG_PWM=y
# CONFIG_PWM_LOG_LEVEL_DBG=y
# CONFIG_CBPRINTF_FP_SUPPORT=y
CONFIG_ADC=y
CONFIG_GPIO=y
# CONFIG_SPI=n
# CONFIG_PM=y
# CONFIG_PM_DEVICE=y
CONFIG_USE_SEGGER_RTT=y
CONFIG_SEGGER_RTT_BUFFER_SIZE_UP=4096
# CONFIG_LOG_BUFFER_SIZE=8192

# CONFIG_NCS_SAMPLES_DEFAULTS=y
CONFIG_ASSERT=y
# CONFIG_ASSERT_NO_MSG_INFO=y
CONFIG_NEWLIB_LIBC=y

# Optimizations.
# CONFIG_CONSOLE=n
# CONFIG_SERIAL=n
# CONFIG_UART_CONSOLE=n
# CONFIG_STDOUT_CONSOLE=n
# CONFIG_PRINTK=n
# CONFIG_EARLY_CONSOLE=n

# So we can use pin P0.10 as GPIO.
CONFIG_NFCT_PINS_AS_GPIOS=y

CONFIG_BT=y
CONFIG_BT_PERIPHERAL=y
CONFIG_BT_DEVICE_NAME="caster"

# BT optmizations.
# CONFIG_BT_DEBUG_NONE=y
# CONFIG_BT_ASSERT=y
# CONFIG_BT_DATA_LEN_UPDATE=n
# CONFIG_BT_PHY_UPDATE=n
# CONFIG_BT_GATT_CACHING=n
# CONFIG_BT_GATT_SERVICE_CHANGED=n
# CONFIG_BT_GAP_PERIPHERAL_PREF_PARAMS=n
# CONFIG_BT_SETTINGS_CCC_LAZY_LOADING=y
# CONFIG_BT_HCI_VS_EXT=n
# CONFIG_BT_EXT_ADV=n
# CONFIG_BT_CTLR_TX_PWR_PLUS_8=y

# LittleFS.
# CONFIG_FLASH=y
# CONFIG_FLASH_MAP=y
# CONFIG_FLASH_PAGE_LAYOUT=y
# CONFIG_FILE_SYSTEM=y
# CONFIG_FILE_SYSTEM_LITTLEFS=y

CONFIG_MAIN_STACK_SIZE=2048
CONFIG_FLASH=y
CONFIG_FLASH_MAP=y
CONFIG_FLASH_PAGE_LAYOUT=y
CONFIG_FILE_SYSTEM=y
CONFIG_FILE_SYSTEM_LITTLEFS=y

# Disable MCUboot.
CONFIG_BOOTLOADER_MCUBOOT=n

# DTW.
# CONFIG_SCLIB_DTW_USE_WINDOWING=n
# CONFIG_SCLIB_DTW_MAX_SIGNAL_LENGTH_MS=2400
```

## src/main.c
```c
#include <sclib/accel.h>
#include <sclib/caster.h>
#include <sclib/led.h>
#include <sclib/macros.h>
#include <sclib/motion_detector.h>
#include <zephyr/kernel.h>
#include <zephyr/logging/log.h>

#include "ble.h"

LOG_MODULE_REGISTER(main, LOG_LEVEL_DBG);

#define SC_BUTTON_PRESS_QUEUE_SIZE 8

struct caster_cb_queue_item {
  uint8_t slot;
};

K_MSGQ_DEFINE(caster_cb_queue, sizeof(struct caster_cb_queue_item),
              SC_BUTTON_PRESS_QUEUE_SIZE, /*align=*/4);

void caster_cb(uint8_t slot) {
  LOG_DBG("Caster callback for slot %d", slot);
  struct caster_cb_queue_item item = {.slot = slot};
  if (k_msgq_put(&caster_cb_queue, &item, K_NO_WAIT)) {
    LOG_ERR("Failed to put item in queue");
  }
}

static void broadcast_action(uint8_t slot) {
  if (sc_ble_set_advertising_data(slot + 1)) {
    LOG_ERR("Failed to set advertising data");
    return;
  }
  sc_ble_start_advertising();
  k_msleep(CONFIG_SC_BLE_ADV_DURATION_MSEC);
  sc_ble_stop_advertising();
  // if (slot == 0) {
  //   LOG_WRN("Got slot 0, putting into low power mode");
  //   sc_accel_sleep();
  // }
}

int main(void) {
  __ASSERT_NO_MSG(!sc_caster_init(caster_cb));
  __ASSERT_NO_MSG(!sc_ble_init());

  // sc_ble_set_advertising_data(1);
  // sc_ble_start_advertising();
  // k_msleep(2000);
  // sc_ble_stop_advertising();

  struct caster_cb_queue_item qitem;
  while (true) {
    k_msgq_get(&caster_cb_queue, &qitem, K_FOREVER);
    LOG_DBG("Got queue item: slot %d", qitem.slot);
    broadcast_action(qitem.slot);
  }
}
```

## src/ble.c
```c
#include "ble.h"

#include <sclib/macros.h>
#include <zephyr/bluetooth/bluetooth.h>
#include <zephyr/logging/log.h>
#include <zephyr/settings/settings.h>

#define PRST_MS_TO_INTERVAL(value_ms) ((uint16_t)(value_ms) / 0.625f)

// LOG_MODULE_REGISTER(ble, CONFIG_LOG_DEFAULT_LEVEL);
LOG_MODULE_REGISTER(ble, 4);

static uint8_t service_data[8] = {0};

static const struct bt_data ad[] = {
    BT_DATA_BYTES(BT_DATA_FLAGS, (BT_LE_AD_GENERAL | BT_LE_AD_NO_BREDR)),
    BT_DATA(BT_DATA_SVC_DATA16, service_data, ARRAY_SIZE(service_data)),
    BT_DATA_BYTES(BT_DATA_NAME_COMPLETE, CONFIG_BT_DEVICE_NAME),
};

static bt_addr_le_t mac_addr;

// bt_addr_le_t.a holds the MAC address in big-endian.
static int get_mac_addr(bt_addr_le_t *out) {
  struct bt_le_oob oob;
  RET_IF_ERR(bt_le_oob_get_local(BT_ID_DEFAULT, &oob));
  const uint8_t *addr = oob.addr.a.val;
  LOG_INF("MAC Address: %02x:%02x:%02x:%02x:%02x:%02x", addr[5], addr[4],
          addr[3], addr[2], addr[1], addr[0]);
  *out = oob.addr;
  return 0;
}

int sc_ble_init(void) {
  RET_IF_ERR(bt_enable(/*bt_reader_cb_t=*/NULL));
  if (IS_ENABLED(CONFIG_SETTINGS)) {
    RET_IF_ERR_MSG(settings_load(), "Error in settings_load()");
  }
  RET_IF_ERR(get_mac_addr(&mac_addr));
  return 0;
}

int sc_ble_start_advertising(void) {
  return bt_le_adv_start(
      BT_LE_ADV_PARAM(BT_LE_ADV_OPT_USE_IDENTITY,
                      PRST_MS_TO_INTERVAL(CONFIG_SC_BLE_MIN_ADV_INTERVAL),
                      PRST_MS_TO_INTERVAL(CONFIG_SC_BLE_MAX_ADV_INTERVAL),
                      /*_peer=*/NULL),
      ad, ARRAY_SIZE(ad),
      /*sd=*/NULL,
      /*sd_len=*/0);
}

int sc_ble_stop_advertising(void) {
  return bt_le_adv_stop();
}

int sc_ble_set_advertising_data(uint8_t n_presses) {
  RET_CHECK(n_presses <= 7, "n_presses must be <= 7");

  static uint8_t pkt_id = 0;

  // 0xfcd2 - bthome.io service UUID.
  service_data[0] = 0xd2;
  service_data[1] = 0xfc;

  // Service header - no encryption, bt home v2.
  service_data[2] = 0x40;

  // Packet ID.
  service_data[3] = 0x00;
  service_data[4] = pkt_id++;

  // We can only encode up to 5 presses as button actions.
  if (n_presses <= 5) {
    // Button.
    service_data[5] = 0x3a;
    service_data[6] = n_presses;
    service_data[7] = 0x00;
  } else {
    // Dimmer.
    service_data[5] = 0x3c;
    service_data[6] = n_presses - 5;
    service_data[7] = n_presses;
  }

  LOG_HEXDUMP_DBG(ad, sizeof(ad), "Encoded BLE adv: ");

  return 0;
}
```

## src/ble.h
```c
#ifndef _SC_BLE_H_
#define _SC_BLE_H_

#include <stdint.h>

int sc_ble_init(void);

int sc_ble_start_advertising(void);

int sc_ble_stop_advertising(void);

int sc_ble_set_advertising_data(uint8_t n_presses);

#endif  // _SC_BLE_H_
```
