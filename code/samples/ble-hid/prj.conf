## CMakeLists.txt
```
cmake_minimum_required(VERSION 3.20.0)

# Pull in the dts/ and boards/ from sclib.
set(DTS_ROOT ${CMAKE_CURRENT_SOURCE_DIR}/../../sclib)
set(BOARD_ROOT ${CMAKE_CURRENT_SOURCE_DIR}/../../sclib)

cmake_minimum_required(VERSION 3.20.0)
find_package(Zephyr REQUIRED HINTS $ENV{ZEPHYR_BASE})

project(ble-hid)

target_sources(app PRIVATE
	src/ble.c
	src/hid.c
	src/main.c
)

add_subdirectory(../../sclib sclib)
target_include_directories(app PRIVATE ../../sclib/include)
target_link_libraries(app PUBLIC sclib)
```

## Kconfig
```
source "Kconfig.zephyr"
rsource "../../sclib/Kconfig"

config SC_BLE_ADV_DURATION_MSEC
	int "Advertising duration in ms."
	default 500

config SC_BLE_MIN_ADV_INTERVAL
	int "Minimum advertising interval in milliseconds"
	default 30

config SC_BLE_MAX_ADV_INTERVAL
	int "Maximum advertising interval in milliseconds"
	default 40

config SC_SLEEP_TIMEOUT_SEC
	int "Sleep timeout in seconds"
	default 5
```

## prj.conf
```kconfig
CONFIG_LOG=y
CONFIG_GPIO=y
CONFIG_ADC=y
CONFIG_PWM=y
CONFIG_I2C=y
CONFIG_SERIAL=n

CONFIG_USE_SEGGER_RTT=y
CONFIG_SEGGER_RTT_BUFFER_SIZE_UP=8196

CONFIG_NEWLIB_LIBC=y
CONFIG_CBPRINTF_FP_SUPPORT=y

CONFIG_ASSERT=y

CONFIG_BT=y
CONFIG_BT_ASSERT=y
CONFIG_BT_DEBUG_LOG=y
CONFIG_BT_MAX_CONN=2
CONFIG_BT_MAX_PAIRED=1
CONFIG_BT_SMP=y
CONFIG_BT_L2CAP_TX_BUF_COUNT=5
CONFIG_BT_PERIPHERAL=y
CONFIG_BT_DEVICE_NAME="spellcaster"
CONFIG_BT_DEVICE_APPEARANCE=961

CONFIG_BT_BAS=y
CONFIG_BT_HIDS=y
CONFIG_BT_HIDS_MAX_CLIENT_COUNT=1
CONFIG_BT_HIDS_DEFAULT_PERM_RW_ENCRYPT=y
CONFIG_BT_GATT_UUID16_POOL_SIZE=40
CONFIG_BT_GATT_CHRC_POOL_SIZE=20

CONFIG_BT_CONN_CTX=y

CONFIG_BT_DIS=y
CONFIG_BT_DIS_PNP=y
CONFIG_BT_DIS_MANUF="rbaron"
CONFIG_BT_DIS_PNP_VID_SRC=2
CONFIG_BT_DIS_PNP_VID=0x1915
CONFIG_BT_DIS_PNP_PID=0xEEEF
CONFIG_BT_DIS_PNP_VER=0x0100

CONFIG_MAIN_STACK_SIZE=4096
CONFIG_SYSTEM_WORKQUEUE_STACK_SIZE=4096

CONFIG_FLASH=y
CONFIG_FLASH_PAGE_LAYOUT=y
CONFIG_FLASH_MAP=y
CONFIG_NVS=y
CONFIG_FILE_SYSTEM=y
CONFIG_FILE_SYSTEM_LITTLEFS=y

# Settings. Since we're using LittleFS mounted on the "storage" partition, we
# eihter need to create a new partition for settings, or use a file. We'll use
# a file for simplicity.
CONFIG_SETTINGS=y
CONFIG_BT_SETTINGS=y
CONFIG_SETTINGS_FILE=y
CONFIG_SETTINGS_FILE_PATH="/lfs/settings"

# So we can use pin P0.10 as GPIO.
CONFIG_NFCT_PINS_AS_GPIOS=y

# Connection interval settings. Basically tradeoff power consumption for latency.
# 160 * 1.25ms = 200ms
CONFIG_BT_PERIPHERAL_PREF_MIN_INT=160
# 320 * 1.25ms = 400ms
CONFIG_BT_PERIPHERAL_PREF_MAX_INT=320
# In units of 10ms.
CONFIG_BT_PERIPHERAL_PREF_TIMEOUT=100

# Disable MCUboot.
CONFIG_BOOTLOADER_MCUBOOT=n
```

## src/main.c
```c
// #include <ram_pwrdn.h>
#include <sclib/adc.h>
#include <sclib/button.h>
#include <sclib/caster.h>
#include <sclib/led.h>
#include <sclib/macros.h>
#include <zephyr/drivers/gpio.h>
#include <zephyr/kernel.h>

#include "ble.h"
#include "hid.h"

LOG_MODULE_REGISTER(app, LOG_LEVEL_DBG);

// Keymap.
static uint8_t get_key_from_slot(uint8_t slot) {
  // https://docs.circuitpython.org/projects/hid/en/latest/_modules/adafruit_hid/keycode.html
  // 0, 1, 2...
  static const uint8_t keymap[] = {
      // 0: 0
      0x27,
      // 1: 1
      0x1e,
      // 2: Play/Pause -- Doesn't really work like this.
      // https://docs.circuitpython.org/projects/hid/en/latest/_modules/adafruit_hid/consumer_control_code.html
      0xcd,
      // 3: R
      0x15,
      // 4: B
      0x05,
      // 5: 5
      0x22,
      // 6: 5
      0x23,
  };
  return keymap[slot];
}

static void caster_cb(uint8_t slot) {
  LOG_INF("caster_cb: slot %d", slot);
  uint8_t key = get_key_from_slot(slot);
  if (!key) {
    LOG_ERR("Failed to get key from button: %d", slot);
    return;
  }
  int err = sc_ble_send_button_press(sc_hid_get_hids_obj(), key);
  if (err) {
    LOG_ERR("Failed to send button press: %d", err);
  }
  err = sc_ble_send_button_release(sc_hid_get_hids_obj(), key);
  if (err) {
    LOG_ERR("Failed to send button release: %d", err);
  }
}

void main(void) {
  LOG_DBG("Will init");
  __ASSERT_NO_MSG(!sc_caster_init(caster_cb));
  __ASSERT_NO_MSG(!sc_adc_init());
  __ASSERT_NO_MSG(!sc_ble_init());
  LOG_DBG("Will init HID");
  __ASSERT_NO_MSG(!sc_hid_init());
  LOG_DBG("Will start advertising");
  __ASSERT_NO_MSG(!sc_ble_start_advertising());

  // Probably shut down unused ram?
  // power_down_unused_ram();

  while (1) {
    k_sleep(K_FOREVER);
  }
}
```

## src/ble.c
```c
#include "ble.h"

#include <sclib/macros.h>
#include <zephyr/bluetooth/bluetooth.h>
#include <zephyr/bluetooth/conn.h>
#include <zephyr/bluetooth/gatt.h>
#include <zephyr/bluetooth/hci.h>
#include <zephyr/bluetooth/services/bas.h>
#include <zephyr/bluetooth/services/dis.h>
#include <zephyr/bluetooth/uuid.h>
#include <zephyr/logging/log.h>
#include <zephyr/settings/settings.h>

#include "hid.h"

#define SC_MS_TO_INTERVAL(value_ms) ((uint16_t)(value_ms) / 0.625f)

// LOG_MODULE_REGISTER(ble, CONFIG_LOG_DEFAULT_LEVEL);
LOG_MODULE_REGISTER(ble, LOG_LEVEL_DBG);

static const struct bt_data ad[] = {
    BT_DATA_BYTES(BT_DATA_GAP_APPEARANCE,
                  (CONFIG_BT_DEVICE_APPEARANCE >> 0) & 0xff,
                  (CONFIG_BT_DEVICE_APPEARANCE >> 8) & 0xff),
    BT_DATA_BYTES(BT_DATA_FLAGS, (BT_LE_AD_GENERAL | BT_LE_AD_NO_BREDR)),
    BT_DATA_BYTES(BT_DATA_UUID16_ALL, BT_UUID_16_ENCODE(BT_UUID_HIDS_VAL),
                  BT_UUID_16_ENCODE(BT_UUID_BAS_VAL)),
};

static const struct bt_data sd[] = {
    BT_DATA_BYTES(BT_DATA_NAME_COMPLETE, CONFIG_BT_DEVICE_NAME),
};

static bt_addr_le_t mac_addr;

static struct k_work pairing_work;
struct pairing_data_mitm {
  struct bt_conn *conn;
  unsigned int passkey;
};

K_MSGQ_DEFINE(mitm_queue, sizeof(struct pairing_data_mitm),
              CONFIG_BT_HIDS_MAX_CLIENT_COUNT, /*max_msgs=*/4);

static struct conn_mode {
  struct bt_conn *conn;
  bool in_boot_mode;
} conn_mode[CONFIG_BT_HIDS_MAX_CLIENT_COUNT];

/*
 * Connection callbacks.
 */
static void connected(struct bt_conn *conn, uint8_t err) {
  char addr[BT_ADDR_LE_STR_LEN];

  bt_addr_le_to_str(bt_conn_get_dst(conn), addr, sizeof(addr));

  if (err) {
    LOG_ERR("Failed to connect to %s (%u)\n", addr, err);
    return;
  }

  LOG_INF("Connected %s\n", addr);

  if (bt_hids_connected(sc_hid_get_hids_obj(), conn)) {
    LOG_ERR("Failed to notify HID service about connection\n");
    return;
  }

  if (err) {
    LOG_ERR("Failed to notify HID service about connection\n");
    return;
  }

  for (size_t i = 0; i < CONFIG_BT_HIDS_MAX_CLIENT_COUNT; i++) {
    if (!conn_mode[i].conn) {
      conn_mode[i].conn = conn;
      conn_mode[i].in_boot_mode = false;
      break;
    }
  }
}

static void disconnected(struct bt_conn *conn, uint8_t reason) {
  int err;
  bool is_any_dev_connected = false;
  char addr[BT_ADDR_LE_STR_LEN];

  bt_addr_le_to_str(bt_conn_get_dst(conn), addr, sizeof(addr));

  // 19 == BT_HCI_ERR_REMOTE_USER_TERM_CONN == 0x13
  LOG_INF("Disconnected from %s (reason %u)\n", addr, reason);

  err = bt_hids_disconnected(sc_hid_get_hids_obj(), conn);

  if (err) {
    LOG_ERR("Failed to notify HID service about disconnection\n");
  }

  for (size_t i = 0; i < CONFIG_BT_HIDS_MAX_CLIENT_COUNT; i++) {
    if (conn_mode[i].conn == conn) {
      conn_mode[i].conn = NULL;
    } else {
      if (conn_mode[i].conn) {
        is_any_dev_connected = true;
      }
    }
  }

  sc_ble_start_advertising();
}

static void security_changed(struct bt_conn *conn, bt_security_t level,
                             enum bt_security_err err) {
  char addr[BT_ADDR_LE_STR_LEN];
  bt_addr_le_to_str(bt_conn_get_dst(conn), addr, sizeof(addr));
  if (!err) {
    LOG_INF("Security changed: %s level %u\n", addr, level);
  } else {
    LOG_ERR("Security failed: %s level %u err %d\n", addr, level, err);
  }
}

BT_CONN_CB_DEFINE(conn_callbacks) = {
    .connected = connected,
    .disconnected = disconnected,
    .security_changed = security_changed,
};

/*
 * Pairing callbacks.
 */

static void pairing_process(struct k_work *work) {
  int err;
  struct pairing_data_mitm pairing_data;

  char addr[BT_ADDR_LE_STR_LEN];

  err = k_msgq_peek(&mitm_queue, &pairing_data);
  if (err) {
    return;
  }

  bt_addr_le_to_str(bt_conn_get_dst(pairing_data.conn), addr, sizeof(addr));

  LOG_WRN("Passkey for %s: %06u\n", addr, pairing_data.passkey);
  LOG_WRN("Press Button 1 to confirm, Button 2 to reject.\n");
}

static void pairing_complete(struct bt_conn *conn, bool bonded) {
  char addr[BT_ADDR_LE_STR_LEN];

  bt_addr_le_to_str(bt_conn_get_dst(conn), addr, sizeof(addr));

  LOG_WRN("Pairing completed: %s, bonded: %d\n", addr, bonded);
}

static void pairing_failed(struct bt_conn *conn, enum bt_security_err reason) {
  char addr[BT_ADDR_LE_STR_LEN];
  struct pairing_data_mitm pairing_data;

  if (k_msgq_peek(&mitm_queue, &pairing_data) != 0) {
    return;
  }

  if (pairing_data.conn == conn) {
    bt_conn_unref(pairing_data.conn);
    k_msgq_get(&mitm_queue, &pairing_data, K_NO_WAIT);
  }

  bt_addr_le_to_str(bt_conn_get_dst(conn), addr, sizeof(addr));

  LOG_WRN("Pairing failed conn: %s, reason %d\n", addr, reason);
}

static struct bt_conn_auth_info_cb conn_auth_info_callbacks = {
    .pairing_complete = pairing_complete, .pairing_failed = pairing_failed};

// bt_addr_le_t.a holds the MAC address in big-endian.
static int get_mac_addr(bt_addr_le_t *out) {
  struct bt_le_oob oob;
  RET_IF_ERR(bt_le_oob_get_local(BT_ID_DEFAULT, &oob));
  const uint8_t *addr = oob.addr.a.val;
  LOG_INF("MAC Address: %02x:%02x:%02x:%02x:%02x:%02x", addr[5], addr[4],
          addr[3], addr[2], addr[1], addr[0]);
  *out = oob.addr;
  return 0;
}

int sc_ble_init() {
  RET_IF_ERR(bt_conn_auth_info_cb_register(&conn_auth_info_callbacks));
  RET_IF_ERR(bt_enable(/*bt_reader_cb_t=*/NULL));
  if (IS_ENABLED(CONFIG_SETTINGS)) {
    int err = settings_load();
    if (err) {
      LOG_ERR("Cannot load settings from flash (err %d)", err);
    }
  }
  RET_IF_ERR(get_mac_addr(&mac_addr));
  k_work_init(&pairing_work, pairing_process);
  return 0;
}

int sc_ble_start_advertising() {
  return bt_le_adv_start(
      BT_LE_ADV_PARAM(BT_LE_ADV_OPT_CONNECTABLE | BT_LE_ADV_OPT_ONE_TIME,
                      SC_MS_TO_INTERVAL(CONFIG_SC_BLE_MIN_ADV_INTERVAL),
                      SC_MS_TO_INTERVAL(CONFIG_SC_BLE_MAX_ADV_INTERVAL),
                      /*_peer=*/NULL),
      ad, ARRAY_SIZE(ad), sd, ARRAY_SIZE(sd));
}

int sc_ble_stop_advertising() {
  return bt_le_adv_stop();
}

int sc_ble_send_button_press(struct bt_hids *hids_obj, uint8_t button) {
  uint8_t data[INPUT_REPORT_KEYS_MAX_LEN] = {0};
  data[0] = 0x00;
  data[1] = 0x00;
  data[2] = button;
  for (size_t i = 0; i < CONFIG_BT_HIDS_MAX_CLIENT_COUNT; i++) {
    if (conn_mode[i].conn) {
      LOG_DBG("Sending button to conn %d", i);
      RET_IF_ERR(bt_hids_inp_rep_send(hids_obj, conn_mode[i].conn,
                                      INPUT_REP_KEYS_IDX, data, sizeof(data),
                                      NULL));
    }
  }
  return 0;
}

int sc_ble_send_button_release(struct bt_hids *hids_obj, uint8_t button) {
  uint8_t data[INPUT_REPORT_KEYS_MAX_LEN] = {0};
  for (size_t i = 0; i < CONFIG_BT_HIDS_MAX_CLIENT_COUNT; i++) {
    if (conn_mode[i].conn) {
      LOG_DBG("Sending button to conn %d", i);
      RET_IF_ERR(bt_hids_inp_rep_send(hids_obj, conn_mode[i].conn,
                                      INPUT_REP_KEYS_IDX, data, sizeof(data),
                                      NULL));
    }
  }
  return 0;
}
```

## src/ble.h
```c
#ifndef _SC_BLE_H_
#define _SC_BLE_H_

#include <bluetooth/services/hids.h>

int sc_ble_init();

int sc_ble_start_advertising();

int sc_ble_stop_advertising();

int sc_ble_send_button_press(struct bt_hids *hids_obj, uint8_t button);

int sc_ble_send_button_release(struct bt_hids *hids_obj, uint8_t button);

#endif  // _SC_BLE_H_
```

## src/hid.c
```c
#include "hid.h"

#include <bluetooth/services/hids.h>
#include <sclib/macros.h>
#include <zephyr/logging/log.h>

#define BASE_USB_HID_SPEC_VERSION 0x0101

#define OUTPUT_REPORT_MAX_LEN 1
#define OUTPUT_REPORT_BIT_MASK_CAPS_LOCK 0x02
#define INPUT_REP_KEYS_REF_ID 1
#define OUTPUT_REP_KEYS_REF_ID 1
#define MODIFIER_KEY_POS 0
#define SHIFT_KEY_CODE 0x02
#define SCAN_CODE_POS 2
#define KEYS_MAX_LEN (INPUT_REPORT_KEYS_MAX_LEN - SCAN_CODE_POS)

BT_HIDS_DEF(hids_obj, OUTPUT_REPORT_MAX_LEN, INPUT_REPORT_KEYS_MAX_LEN);

LOG_MODULE_REGISTER(hid, CONFIG_LOG_DEFAULT_LEVEL);

static void hids_boot_kb_outp_rep_handler(struct bt_hids_rep *rep,
                                          struct bt_conn *conn, bool write) {
  LOG_INF("hids_boot_kb_outp_rep_handler");
}

static void hids_outp_rep_handler(struct bt_hids_rep *rep, struct bt_conn *conn,
                                  bool write) {
  LOG_INF("hids_outp_rep_handler");
}

static void hids_pm_evt_handler(enum bt_hids_pm_evt evt, struct bt_conn *conn) {
  LOG_INF("hids_pm_evt_handler");
}

int sc_hid_init(void) {
  struct bt_hids_init_param hids_init_obj = {0};
  struct bt_hids_inp_rep *hids_inp_rep;
  struct bt_hids_outp_feat_rep *hids_outp_rep;

  static const uint8_t report_map[] = {
    0x05,
    0x01, /* Usage Page (Generic Desktop) */
    0x09,
    0x06, /* Usage (Keyboard) */
    0xA1,
    0x01, /* Collection (Application) */

  /* Keys */
#if INPUT_REP_KEYS_REF_ID
    0x85,
    INPUT_REP_KEYS_REF_ID,
#endif
    0x05,
    0x07, /* Usage Page (Key Codes) */
    0x19,
    0xe0, /* Usage Minimum (224) */
    0x29,
    0xe7, /* Usage Maximum (231) */
    0x15,
    0x00, /* Logical Minimum (0) */
    0x25,
    0x01, /* Logical Maximum (1) */
    0x75,
    0x01, /* Report Size (1) */
    0x95,
    0x08, /* Report Count (8) */
    0x81,
    0x02, /* Input (Data, Variable, Absolute) */

    0x95,
    0x01, /* Report Count (1) */
    0x75,
    0x08, /* Report Size (8) */
    0x81,
    0x01, /* Input (Constant) reserved byte(1) */

    0x95,
    0x06, /* Report Count (6) */
    0x75,
    0x08, /* Report Size (8) */
    0x15,
    0x00, /* Logical Minimum (0) */
    0x25,
    0x65, /* Logical Maximum (101) */
    0x05,
    0x07, /* Usage Page (Key codes) */
    0x19,
    0x00, /* Usage Minimum (0) */
    0x29,
    0x65, /* Usage Maximum (101) */
    0x81,
    0x00, /* Input (Data, Array) Key array(6 bytes) */

  /* LED */
#if OUTPUT_REP_KEYS_REF_ID
    0x85,
    OUTPUT_REP_KEYS_REF_ID,
#endif
    0x95,
    0x05, /* Report Count (5) */
    0x75,
    0x01, /* Report Size (1) */
    0x05,
    0x08, /* Usage Page (Page# for LEDs) */
    0x19,
    0x01, /* Usage Minimum (1) */
    0x29,
    0x05, /* Usage Maximum (5) */
    0x91,
    0x02, /* Output (Data, Variable, Absolute), */
          /* Led report */
    0x95,
    0x01, /* Report Count (1) */
    0x75,
    0x03, /* Report Size (3) */
    0x91,
    0x01, /* Output (Data, Variable, Absolute), */
          /* Led report padding */

    0xC0 /* End Collection (Application) */
  };

  hids_init_obj.rep_map.data = report_map;
  hids_init_obj.rep_map.size = sizeof(report_map);

  hids_init_obj.info.bcd_hid = BASE_USB_HID_SPEC_VERSION;
  hids_init_obj.info.b_country_code = 0x00;
  hids_init_obj.info.flags =
      (BT_HIDS_REMOTE_WAKE | BT_HIDS_NORMALLY_CONNECTABLE);

  hids_inp_rep = &hids_init_obj.inp_rep_group_init.reports[INPUT_REP_KEYS_IDX];
  hids_inp_rep->size = INPUT_REPORT_KEYS_MAX_LEN;
  hids_inp_rep->id = INPUT_REP_KEYS_REF_ID;
  hids_init_obj.inp_rep_group_init.cnt++;

  hids_outp_rep =
      &hids_init_obj.outp_rep_group_init.reports[OUTPUT_REP_KEYS_IDX];
  hids_outp_rep->size = OUTPUT_REPORT_MAX_LEN;
  hids_outp_rep->id = OUTPUT_REP_KEYS_REF_ID;
  hids_outp_rep->handler = hids_outp_rep_handler;
  hids_init_obj.outp_rep_group_init.cnt++;

  hids_init_obj.is_kb = true;
  hids_init_obj.boot_kb_outp_rep_handler = hids_boot_kb_outp_rep_handler;
  hids_init_obj.pm_evt_handler = hids_pm_evt_handler;

  RET_IF_ERR(bt_hids_init(&hids_obj, &hids_init_obj));
  return 0;
}

struct bt_hids *sc_hid_get_hids_obj() {
  return &hids_obj;
}
```

## src/hid.h
```c
#ifndef _SC_HID_H_
#define _SC_HID_H_

// Max keys pressed at the same time.
#define KEY_PRESS_MAX 6
// Number of bytes in key report.
#define INPUT_REPORT_KEYS_MAX_LEN (1 + 1 + KEY_PRESS_MAX)

enum { OUTPUT_REP_KEYS_IDX = 0 };

enum { INPUT_REP_KEYS_IDX = 0 };

int sc_hid_init(void);

struct bt_hids *sc_hid_get_hids_obj();

#endif  // _SC_HID_H_
```
