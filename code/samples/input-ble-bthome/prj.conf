## CMakeLists.txt
```
cmake_minimum_required(VERSION 3.20.0)

# Pull in the dts/ and boards/ from sclib.
set(DTS_ROOT ${CMAKE_CURRENT_SOURCE_DIR}/../../sclib)
set(BOARD_ROOT ${CMAKE_CURRENT_SOURCE_DIR}/../../sclib)

cmake_minimum_required(VERSION 3.20.0)
find_package(Zephyr REQUIRED HINTS $ENV{ZEPHYR_BASE})

project(input-ble-bthome)

target_sources(app PRIVATE
	src/ble.c
	src/main.c
)

add_subdirectory(../../sclib sclib)
target_include_directories(app PRIVATE ../../sclib/include)
target_link_libraries(app PUBLIC sclib)
```

## prj.conf
```kconfig
CONFIG_LOG=y
CONFIG_GPIO=y
CONFIG_ADC=y
CONFIG_SERIAL=n

CONFIG_USE_SEGGER_RTT=y
CONFIG_SEGGER_RTT_BUFFER_SIZE_UP=4096

# CONFIG_NEWLIB_LIBC=y
# CONFIG_NEWLIB_LIBC_FLOAT_PRINTF=y

CONFIG_ASSERT=y

# CONFIG_PM=y
# CONFIG_PM_DEVICE=y

CONFIG_BT=y
CONFIG_BT_PERIPHERAL=y
CONFIG_BT_DEVICE_NAME="spellcaster"
CONFIG_BT_CTLR_TX_PWR_PLUS_8=y

# Debug log level.
# CONFIG_LOG_DEFAULT_LEVEL=4

CONFIG_MAIN_STACK_SIZE=2048
CONFIG_FLASH=y
CONFIG_FLASH_MAP=y
CONFIG_FLASH_PAGE_LAYOUT=y
CONFIG_FILE_SYSTEM=y
CONFIG_FILE_SYSTEM_LITTLEFS=y
```

## src/main.c
```c
#include <sclib/button.h>
#include <sclib/led.h>
#include <sclib/macros.h>
#include <zephyr/drivers/gpio.h>
#include <zephyr/kernel.h>

#include "ble.h"

LOG_MODULE_REGISTER(app, CONFIG_LOG_DEFAULT_LEVEL);

#define SC_BUTTON_PRESS_QUEUE_SIZE 8

typedef struct {
  sc_button_t button;
  sc_button_event_t event;
} button_press_queue_element_t;

K_MSGQ_DEFINE(button_press_queue, sizeof(button_press_queue_element_t),
              SC_BUTTON_PRESS_QUEUE_SIZE, 4);

static void button_press_cb(sc_button_t button, sc_button_event_t event) {
  LOG_DBG("button_press_cb: button %d - event %d", button, event);
  button_press_queue_element_t qel = {.button = button, .event = event};
  k_msgq_put(&button_press_queue, &qel, K_FOREVER);
}

static void broadcast_button_press(sc_button_t button,
                                   sc_button_event_t event) {
  sc_led_flash(/*times=*/1);
  sc_ble_set_advertising_data(button, event);
  sc_ble_start_advertising();
  k_msleep(CONFIG_SC_BLE_ADV_DURATION_MSEC);
  sc_ble_stop_advertising();
}

void main(void) {
  __ASSERT_NO_MSG(!sc_button_init());
  __ASSERT_NO_MSG(!sc_led_init());
  __ASSERT_NO_MSG(!sc_ble_init());

  __ASSERT_NO_MSG(!sc_button_register_callback(button_press_cb));

  sc_led_flash(/*times=*/2);

  button_press_queue_element_t qel;
  while (1) {
    k_msgq_get(&button_press_queue, &qel, K_FOREVER);
    LOG_DBG("main: button %d - event %d", qel.button, qel.event);
    broadcast_button_press(qel.button, qel.event);
  }
}
```

## src/ble.c
```c
#include "ble.h"

#include <sclib/macros.h>
#include <zephyr/bluetooth/bluetooth.h>
#include <zephyr/logging/log.h>
#include <zephyr/settings/settings.h>

#define PRST_MS_TO_INTERVAL(value_ms) ((uint16_t)(value_ms) / 0.625f)

// LOG_MODULE_REGISTER(ble, CONFIG_LOG_DEFAULT_LEVEL);
LOG_MODULE_REGISTER(ble, 4);

static uint8_t service_data[7] = {0};

static const struct bt_data ad[] = {
    BT_DATA_BYTES(BT_DATA_FLAGS, (BT_LE_AD_GENERAL | BT_LE_AD_NO_BREDR)),
    BT_DATA(BT_DATA_SVC_DATA16, service_data, ARRAY_SIZE(service_data)),
    BT_DATA_BYTES(BT_DATA_NAME_COMPLETE, CONFIG_BT_DEVICE_NAME),
};

static bt_addr_le_t mac_addr;

// bt_addr_le_t.a holds the MAC address in big-endian.
static int get_mac_addr(bt_addr_le_t *out) {
  struct bt_le_oob oob;
  RET_IF_ERR(bt_le_oob_get_local(BT_ID_DEFAULT, &oob));
  const uint8_t *addr = oob.addr.a.val;
  LOG_INF("MAC Address: %02x:%02x:%02x:%02x:%02x:%02x", addr[5], addr[4],
          addr[3], addr[2], addr[1], addr[0]);
  *out = oob.addr;
  return 0;
}

int sc_ble_init() {
  RET_IF_ERR(bt_enable(/*bt_reader_cb_t=*/NULL));
  if (IS_ENABLED(CONFIG_SETTINGS)) {
    RET_IF_ERR_MSG(settings_load(), "Error in settings_load()");
  }
  RET_IF_ERR(get_mac_addr(&mac_addr));
  return 0;
}

int sc_ble_start_advertising() {
  return bt_le_adv_start(
      BT_LE_ADV_PARAM(BT_LE_ADV_OPT_USE_IDENTITY,
                      PRST_MS_TO_INTERVAL(CONFIG_SC_BLE_MIN_ADV_INTERVAL),
                      PRST_MS_TO_INTERVAL(CONFIG_SC_BLE_MAX_ADV_INTERVAL),
                      /*_peer=*/NULL),
      ad, ARRAY_SIZE(ad),
      /*sd=*/NULL,
      /*sd_len=*/0);
}

int sc_ble_stop_advertising() {
  return bt_le_adv_stop();
}

void sc_ble_set_advertising_data(sc_button_t button, sc_button_event_t event) {
  static uint8_t pkt_id = 0;

  // 0xfcd2 - bthome.io service UUID.
  service_data[0] = 0xd2;
  service_data[1] = 0xfc;

  // Service header - no encryption, bt home v2.
  service_data[2] = 0x40;

  // Packet ID.
  service_data[3] = 0x00;
  service_data[4] = pkt_id++;

  // Button.
  service_data[5] = 0x3a;
  // Short press.
  switch (event) {
    case SC_BUTTON_EVENT_SHORT_PRESS:
      service_data[6] = 0x01;
      break;
    case SC_BUTTON_EVENT_DOUBLE_PRESS:
      service_data[6] = 0x02;
      break;
    case SC_BUTTON_EVENT_TRIPLE_PRESS:
      service_data[6] = 0x03;
      break;
    case SC_BUTTON_EVENT_LONG_PRESS:
      service_data[6] = 0x04;
      break;
    default:
      LOG_ERR("Invalid button event: %d", event);
      break;
  }

  LOG_HEXDUMP_DBG(ad, sizeof(ad), "Encoded BLE adv: ");
}
```

## src/ble.h
```c
#ifndef _SC_BLE_H_
#define _SC_BLE_H_

#include <sclib/button.h>

int sc_ble_init();

int sc_ble_start_advertising();

int sc_ble_stop_advertising();

void sc_ble_set_advertising_data(sc_button_t button, sc_button_event_t event);

#endif  // _SC_BLE_H_
```
