## CMakeLists.txt
```
cmake_minimum_required(VERSION 3.20.0)

# Pull in the dts/ and boards/ from sclib.
set(DTS_ROOT ${CMAKE_CURRENT_SOURCE_DIR}/../../sclib)
set(BOARD_ROOT ${CMAKE_CURRENT_SOURCE_DIR}/../../sclib)

find_package(Zephyr REQUIRED HINTS $ENV{ZEPHYR_BASE})
project(motion_detector)

target_sources(app PRIVATE src/main.c)

add_subdirectory(../../sclib sclib)
target_include_directories(app PRIVATE ../../sclib/include)
target_link_libraries(app PUBLIC sclib)
```

## Kconfig
```
source "Kconfig.zephyr"
rsource "../../sclib/Kconfig"
```

## prj.conf
```kconfig
CONFIG_PINCTRL=y
CONFIG_I2C=y
CONFIG_LOG=y
CONFIG_PWM=y
CONFIG_PWM_LOG_LEVEL_DBG=y
CONFIG_CBPRINTF_FP_SUPPORT=y
CONFIG_ADC=y
CONFIG_GPIO=y
CONFIG_PM=y
CONFIG_PM_DEVICE=y
CONFIG_USE_SEGGER_RTT=y
CONFIG_ASSERT=y
```

## src/main.c
```c
#include <sclib/accel.h>
#include <sclib/led.h>
#include <sclib/macros.h>
#include <sclib/motion_detector.h>
#include <zephyr/kernel.h>
#include <zephyr/logging/log.h>

LOG_MODULE_REGISTER(main, LOG_LEVEL_DBG);

int main(void) {
  sc_led_init();
  sc_accel_init();

  struct sc_motion_detector md;
  sc_md_init(&md);

  // sd_led_flash(2);

  struct sc_accel_entry entry;
  while (true) {
    if (!sc_accel_read(&entry)) {
      sc_md_ingest(&md, &entry);
    }
  }
}
```
